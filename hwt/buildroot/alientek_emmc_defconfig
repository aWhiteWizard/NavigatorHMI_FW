## hwt/buildroot/alientek_emmc_defconfig
```kconfig
# Buildroot 2019.02.6 配置 - 正点原子 i.MX6ULL ALIENTEK EMMC
# ============================================================
# Buildroot 只负责 rootfs + sdcard.img 打包
# Linux 内核和 U-Boot 由单独脚本编译后注入 images 目录
# ============================================================

# --- 架构 ---
BR2_arm=y
BR2_cortex_a7=y
BR2_ARM_FPU_NEON_VFPV4=y

# --- 工具链 ---
# 注意：以下外部工具链配置缺少 BR2_TOOLCHAIN_EXTERNAL_CUSTOM，实际并未生效。
# 真实使用的是 Buildroot 内部工具链（gcc 8.x + glibc 2.28），
# 应用/Qt（Linaro 4.9.4, glibc 2.19）在其上运行正常（glibc 向前兼容），保持现状。
BR2_TOOLCHAIN_EXTERNAL=y
BR2_TOOLCHAIN_EXTERNAL_PATH="/opt/gcc-linaro-4.9.4-2017.01-i686_arm-linux-gnueabihf"
BR2_TOOLCHAIN_EXTERNAL_PREFIX="arm-linux-gnueabihf"

# --- 系统配置 ---
BR2_TARGET_GENERIC_HOSTNAME="NavigatorHMI"
BR2_TARGET_GENERIC_GETTY_PORT="ttymxc0"
BR2_TARGET_GENERIC_GETTY_BAUDRATE="115200"
BR2_ROOTFS_POST_IMAGE_SCRIPT="board/freescale/common/imx/post-image.sh"

# --- 不编译 Linux 内核（由外部提供）---
# BR2_LINUX_KERNEL 不启用，用单独编译的 zImage + dtb

# --- 不编译 U-Boot（由外部提供）---
# BR2_TARGET_UBOOT 不启用，用单独编译的 u-boot-dtb.imx

# --- SD 卡镜像工具 ---
BR2_PACKAGE_HOST_DOSFSTOOLS=y
BR2_PACKAGE_HOST_GENIMAGE=y
BR2_PACKAGE_HOST_MTOOLS=y

# --- 文件系统 ---
BR2_TARGET_ROOTFS_EXT2=y
BR2_TARGET_ROOTFS_EXT2_4=y
BR2_TARGET_ROOTFS_EXT2_SIZE="256M"

# --- 应用（将 NavigatorHMI_FW 放入 rootfs）---
# 通过 rootfs-overlay 机制部署
# BR2_ROOTFS_OVERLAY 在 build-linux-uboot.sh 中动态设置

# --- 第三方软件包（Navigator HMI 实用集）---
# 远程调试/网络
BR2_PACKAGE_OPENSSH=y
BR2_PACKAGE_OPENSSL=y
BR2_PACKAGE_IPROUTE2=y
BR2_PACKAGE_VSFTPD=y
# 调试工具
BR2_PACKAGE_GDB=y
BR2_PACKAGE_GDB_SERVER=y
BR2_PACKAGE_GDB_DEBUGGER=y
BR2_PACKAGE_MINICOM=y
# CAN 总线
BR2_PACKAGE_CAN_UTILS=y
# 音频（导航语音）
BR2_PACKAGE_ALSA_LIB=y
BR2_PACKAGE_ALSA_UTILS=y
BR2_PACKAGE_ALSA_UTILS_APLAY=y
BR2_PACKAGE_ALSA_UTILS_ARECORD=y
BR2_PACKAGE_ALSA_UTILS_AMIXER=y
# WiFi
BR2_PACKAGE_WPA_SUPPLICANT=y
BR2_PACKAGE_LIBNL=y
# 触摸屏校准工具
BR2_PACKAGE_TSLIB=y
# 4G 拨号（备用）
BR2_PACKAGE_PPPD=y
# 压缩库
BR2_PACKAGE_ZLIB=y
# 熵采集守护（修复开机 getrandom 阻塞等熵池 ~2 分钟）
BR2_PACKAGE_HAVEGED=y
```

## hwt/uboot/configs/uboot_hwt_defconfig
```kconfig
# uboot_hwt_defconfig - 基于正点原子 i.MX6ULL ALIENTEK EMMC
# 原始配置: mx6ull_alientek_emmc_defconfig (+ 自定义扩展)
CONFIG_SYS_EXTRA_OPTIONS="IMX_CONFIG=board/freescale/mx6ull_alientek_emmc/imximage.cfg,MX6ULL_EVK_EMMC_REWORK"
CONFIG_ARM=y
CONFIG_ARCH_MX6=y
CONFIG_TARGET_MX6ULL_ALIENTEK_EMMC=y
CONFIG_CMD_GPIO=y
CONFIG_CMD_DHCP=y
CONFIG_CMD_PING=y
CONFIG_CMD_MMC=y
CONFIG_CMD_FAT=y
CONFIG_CMD_EXT2=y
CONFIG_CMD_EXT4=y
CONFIG_CMD_BOOTZ=y
CONFIG_HUSH_PARSER=y
CONFIG_SD_BOOT=y
CONFIG_ENV_IS_IN_MMC=y
CONFIG_ENV_SIZE=0x2000
CONFIG_ENV_OFFSET=0xC0000
CONFIG_FSL_USDHC=y
CONFIG_SYS_MMC_ENV_DEV=0
CONFIG_SYS_LOAD_ADDR=0x80800000
CONFIG_MMCROOT="/dev/mmcblk0p2"
```
